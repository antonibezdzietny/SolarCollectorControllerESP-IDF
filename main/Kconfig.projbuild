## main/Kconfig.projbuild
```kconfig
menu "Collector Configuration"
    config MIN_TEMP
        int "Minimal temperature to start running pump"
        default  30
    
    config D_GEAR_1
        int "Minimal difference value for starting gear 1."
        default  5

    config  D_GEAR_2
        int  "Minimal difference value for starting gear 2"
        default 10

    config  D_GEAR_3
        int  "Minimal difference value for starting gear 3"
        default 15

    config MAX_TEMP
        int "Maximal temperature for open extra IN4"
        default 85
endmenu

menu "Devices Configuration"
    menu "Joystick"
        config SW_PIN
            int "SW PIN"
            default 2

        config X_ADC_PIN
            int "PIN_X"
            default 4
        
        config X_ADC_UNIT
            int "PIN_X_ADC_UNIT"
            default 1
            
        config X_ADC_CHANNEL
            int "PIN_X_ADC_CHANNEL"
            default 0

        config Y_ADC_PIN
            int "PIN_Y"
            default 15
        
        config Y_ADC_UNIT
            int "PIN_Y_ADC_UNIT"
            default 1
            
        config Y_ADC_CHANNEL
            int "PIN_Y_ADC_CHANNEL"
            default 3
    endmenu
    
    menu "Display"
        config DISPLAY_RS
            int "DISPLAY_RS"
            default 16

        config DISPLAY_EN
            int "DISPLAY_E"
            default 17

        config DISPLAY_D4
            int "DISPLAY_D4"
            default 5

        config DISPLAY_D5
            int "DISPLAY_D5"
            default 18

        config DISPLAY_D6
            int "DISPLAY_D6"
            default 19

        config DISPLAY_D7
            int "DISPLAY_D7"
            default 21
    endmenu

    menu "Thermometers"
        config ONE_WIRE_PIN
            int "Thermometers (one wire) pin"
            default 33

        config COLLECTOR_ONE_W_ADDRESS
            hex "Address collector thermometer sensor"
            default "593c01f095cab528"  

        config PIPE_ONE_W_ADDRESS
            hex "Address pipe thermometer sensor"
            default "5e3c01f09521d728"  
    endmenu

    menu "Relay"
        config RELAY_IN_1_PIN
            int "RELAY_IN_1_PIN"
            default 14

        config RELAY_IN_2_PIN
            int "RELAY_IN_2_PIN"
            default 27

        config RELAY_IN_3_PIN
            int "RELAY_IN_3_PIN"
            default 26

        config RELAY_IN_4_PIN
            int "RELAY_IN_5_PIN"
            default 25

    endmenu
endmenu
```
